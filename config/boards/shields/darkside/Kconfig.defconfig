## config/boards/shields/darkside/Kconfig.defconfig
```kconfig
# Copyright (c) 2020 The ZMK Contributors
# SPDX-License-Identifier: MIT

if SHIELD_DARKSIDE_LEFT

config ZMK_KEYBOARD_NAME
    default "Darkside"
	
config ZMK_SPLIT_BLE_ROLE_CENTRAL
    default y

endif


if SHIELD_DARKSIDE_LEFT || SHIELD_DARKSIDE_RIGHT

config ZMK_SPLIT
    default y

endif
```

## config/boards/shields/darkside/Kconfig.shield
```kconfig
# Copyright (c) 2020 The ZMK Contributors
# SPDX-License-Identifier: MIT

config SHIELD_DARKSIDE_LEFT
    def_bool $(shields_list_contains,darkside_left)
	
config SHIELD_DARKSIDE_RIGHT
    def_bool $(shields_list_contains,darkside_right)
```

## config/boards/shields/knob68/Kconfig.defconfig
```kconfig
# Copyright (c) 2020 The ZMK Contributors
# SPDX-License-Identifier: MIT

if SHIELD_KNOB68

config ZMK_KEYBOARD_NAME
    default "Knob68"

endif
```

## config/boards/shields/knob68/Kconfig.shield
```kconfig
# Copyright (c) 2020 The ZMK Contributors
# SPDX-License-Identifier: MIT

config SHIELD_KNOB68
    def_bool $(shields_list_contains,knob68)
```
